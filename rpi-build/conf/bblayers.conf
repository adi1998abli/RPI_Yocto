## rpi-build/conf/bblayers.conf
```bitbake
# POKY_BBLAYERS_CONF_VERSION is increased each time build/conf/bblayers.conf
# changes incompatibly
POKY_BBLAYERS_CONF_VERSION = "2"

BBPATH = "${TOPDIR}"
BBFILES ?= ""

BBLAYERS ?= " \
  /home/adi/Yocto_Project/poky/meta \
  /home/adi/Yocto_Project/poky/meta-poky \
  /home/adi/Yocto_Project/poky/meta-yocto-bsp \
  /home/adi/Yocto_Project/meta-raspberrypi \
  /home/adi/Yocto_Project/meta-openembedded/meta-oe \
  /home/adi/Yocto_Project/meta-openembedded/meta-python \
  /home/adi/Yocto_Project/meta-openembedded/meta-networking \
  /home/adi/Yocto_Project/meta-openembedded/meta-multimedia \
  /home/adi/Yocto_Project/meta-qt5 \
  "
```
